## sdkconfig.defaults.bread_compact_wifi_128x64_vi
```kconfig
CONFIG_BOARD_TYPE_BREAD_COMPACT_WIFI=y
CONFIG_OLED_SSD1306_128X64=y
CONFIG_LANGUAGE_VI_VN=y
CONFIG_XIAOZHI_DISABLE_AUTO_FIRMWARE_UPGRADE=y
CONFIG_OTA_URL="https://api.tenclass.net/xiaozhi/ota/"
CONFIG_ESP_CONSOLE_USB_SERIAL_JTAG=y
CONFIG_ESP_CONSOLE_SECONDARY_NONE=y
```

## sdkconfig.defaults.internal_lcd
```kconfig
CONFIG_BOARD_TYPE_BREAD_COMPACT_WIFI_LCD=y
CONFIG_LCD_ST7789_240X320=y
CONFIG_OTA_URL="http://192.168.1.151:803/xiaozhi/ota/"
```

## sdkconfig.defaults.internal_oled096
```kconfig
CONFIG_BOARD_TYPE_XINGZHI_CUBE_0_96OLED_WIFI=y
CONFIG_LANGUAGE_VI_VN=y
CONFIG_OTA_URL="http://192.168.1.151:803/xiaozhi/ota/"
```
