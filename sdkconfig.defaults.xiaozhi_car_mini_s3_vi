## sdkconfig.defaults.xiaozhi_car_mini_s3_vi
```kconfig
CONFIG_BOARD_TYPE_XIAOZHI_CAR_MINI_S3=y
CONFIG_CONTROL_CAR_ROLE_CHILD=y
CONFIG_CONTROL_CAR_CHILD_COMMAND_PORT=8081
CONFIG_OLED_SSD1306_128X64=y
CONFIG_LANGUAGE_VI_VN=y
CONFIG_XIAOZHI_DISABLE_AUTO_FIRMWARE_UPGRADE=y
CONFIG_WAKE_WORD_DETECTION_IN_LISTENING=y
CONFIG_OTA_URL="https://api.tenclass.net/xiaozhi/ota/"
CONFIG_ESP_CONSOLE_UART_DEFAULT=y
CONFIG_ESP_CONSOLE_SECONDARY_NONE=y
```
